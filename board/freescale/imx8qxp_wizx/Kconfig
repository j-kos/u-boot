## board/freescale/imx8qxp_wizx/Kconfig
```kconfig
if TARGET_IMX8QXP_WIZX

config SYS_BOARD
	default "imx8qxp_wizx"

config SYS_VENDOR
	default "freescale"

config SYS_CONFIG_NAME
	default "imx8qxp_wizx"

source "board/freescale/common/Kconfig"

endif
```
